## bstd/src/ble/Kconfig
```kconfig
menu "Ble Enable menu"
config BLE_ENABLE
	bool  "Build source code for Ble enable"
	default n
	help
	  Build source code for ble enable
endmenu
```

## bstd/src/common/Kconfig
```kconfig
menu "Common menu"
config COMMON_ENABLE
	bool "Build source code for Common"
	default y
	help
	  Build source code for Common
endmenu
```

## bstd/src/commu/Kconfig
```kconfig
menu "Commu Enable menu"
config COMMU_ENABLE
	bool  "Build source code for Commu enable"
	default n
	help
	  Build source code for Commu enable
endmenu
```

## bstd/src/dev_sett/Kconfig
```kconfig
menu "Dev setting menu"
config DEV_SETT
	bool  "Build source code for dev setting"
	default n
	help
	  Build source code for dev setting
endmenu
```

## bstd/src/feature/ft_b/Kconfig
```kconfig
menu "ft_b menu"
config FT_B_ENABLE
	bool  "Build source code for ft_b"
	default y
	help
	  Build source code for ft_b
endmenu
```

## bstd/src/netwrk/Kconfig
```kconfig
menu "Netwrok module menu"
config NETWORK_MOD
	bool  "Build source code for Netwrok module"
	default n
	help
	  Build source code for Netwrok module
endmenu
```

## bstd/src/nvs_mgr/Kconfig
```kconfig
menu "NVS Mgr Enable menu"
config NVS_MGR_ENABLE
	bool  "Build source code for NVS Mgr enable"
	default n
	help
	  Build source code for NVS Mgr enable
endmenu
```

## bstd/src/sensor/Kconfig
```kconfig
menu "Sensor menu"
config SENSOR
	bool "Build source code for Sensor"
	default n
	help
	  Build source code for Sensor
endmenu
```

## bstd/src/shell/Kconfig
```kconfig
menu "SHELL_MOD menu"
config SHELL_MOD
	bool "Build source code for SHELL_MOD"
	default n
	help
	  Build source code for SHELL_MOD
endmenu
```
